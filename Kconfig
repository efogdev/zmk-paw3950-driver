## Kconfig
```kconfig
# Sensor data simulator
#
# Copyright (c) 2019 Nordic Semiconductor
#
# SPDX-License-Identifier: LicenseRef-Nordic-5-Clause
#

menuconfig PAW3950
  bool "PAW3950 mouse optical sensor"
  select SPI
  depends on INPUT
  depends on DT_HAS_PIXART_PAW3950_ENABLED
  help
      Enable PAW3950 mouse optical sensor.

if PAW3950

config INPUT_PAW3950_INIT_PRIORITY
    int "PAW3950 initialization priority"
    default INPUT_INIT_PRIORITY

config PAW3950_SWAP_XY
  bool "Swap the X/Y axis of PAW3950 sensor"

config PAW3950_INVERT_X
  bool "Invert the X axis of PAW3950 sensor"

config PAW3950_INVERT_Y
  bool "Invert the Y axis of PAW3950 sensor"

config PAW3950_INIT_POWER_UP_EXTRA_DELAY_MS
  int "Extra power up init delay (ms)"
  default 0
  help
    Default minimum init power up delay is 10ms.
    Use this config to postpone init power up sequence if needs longer bootup time.

config PAW3950_IGNORE_FIRST_N
  int "Ignore first N data points"
  default 8
  help
    Ignore first N data points after initialization to prevent cursor jump.

config PAW3950_CALIBRATION_TIMEOUT_MS
  int "Manual calibration timeout"
  default 10000

config PAW3950_REPORT_INTERVAL_MIN
	int "PAW3950's default minimum report rate"
	default 0
	help
	  Default minimum report interval in milliseconds.
		Slow down input reporting for hid queue over the air.
		Turn value down to 8ms to get sharp response if use with USB only.

config PAW3950_INIT_FAILURE_THRESHOLD
    int "Number of failed initialization attempts before triggering error"
    default 3
    range 0 255
    help
      Number of consecutive failed initialization attempts before triggering
      an adaptive feedback error slot equal to the sensor instance index.
      Set to 0 to disable error triggering.

module = PAW3950
module-str = PAW3950
source "${ZEPHYR_BASE}/subsys/logging/Kconfig.template.log_config"

endif #PAW3950
```

## dts/bindings/behaviors/zmk,behavior-paw3950-calibrate.yaml
```yaml
description: PAW3950 calibrate behavior
compatible: "zmk,behavior-paw3950-calibrate"
include: zero_param.yaml

properties:
  bindings:
    type: phandle
    required: true
    description: The PAW3950 sensor instance

  feedback-gpios:
    type: phandle-array
    required: false

  feedback-extra-gpios:
    type: phandle-array
    required: false

  feedback-duration:
    type: int
    default: 0
    description: Duration of the feedback pulse in ms
```

## dts/bindings/behaviors/zmk,behavior-paw3950-power-mode-toggle.yaml
```yaml
description: PAW3950 power mode toggle behavior
compatible: "zmk,behavior-paw3950-power-mode-toggle"
include: two_param.yaml

properties:
  bindings:
    type: phandle
    required: true
    description: The PAW3950 sensor instance

  feedback-gpios:
    type: phandle-array
    required: false

  feedback-extra-gpios:
    type: phandle-array
    required: false

  feedback-duration:
    type: int
    default: 0
    description: Duration of the feedback pulse in ms
```

## dts/bindings/pixart,paw3950.yml
```yaml
description: |
  Sensor driver for the pixart PAW3950 mouse sensor 

compatible: "pixart,paw3950"

include: spi-device.yaml

properties:
  irq-gpios:
    type: phandle-array
    required: true
  cpi:
    type: int
    default: 600
    description: "CPI value (Range: 50 - 30000, Step: 50)"
  swap-xy:
    type: boolean
  invert-x:
    type: boolean
  invert-y:
    type: boolean
  evt-type:
    type: int
    required: true
  x-input-code:
    type: int
    required: true
  y-input-code:
    type: int
    required: true
  power-mode:
    type: int
    default: 0
    description: |
      Power mode
      0: High power
      1: Low power
      2: Office
  liftoff-dist:
    type: int
    default: 0
    description: |
      Universal lift cut-off (raw Lift_Config register value).
      0x00 (0):   0.7 mm (default)
      0x85 (133): 1.0 mm
      0x8F (143): 2.0 mm
      See PAW3950_LIFT_CONFIG_* in dt-bindings/zmk/paw3950-modes.h.
  force-awake:
    type: boolean
  ripple-control:
    type: boolean
  init-retry-count:
    type: int
    default: 5
    description: "Number of retries for initialization"
  init-retry-interval:
    type: int
    default: 100
    description: "Interval between initialization retries in ms"
```
